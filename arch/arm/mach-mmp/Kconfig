## arch/arm/mach-mmp/Kconfig
```kconfig
if ARCH_MMP

choice
	prompt "Marvell MMP board select"
	default TARGET_COREPRIMEVELTE

config TARGET_COREPRIMEVELTE
	bool "Samsung Galaxy Core Prime VE LTE (PXA1908)"
	select ARM64
	select LINUX_KERNEL_IMAGE_HEADER
	select SAVE_PREV_BL_FDT_ADDR
	select SAVE_PREV_BL_INITRAMFS_START_ADDR

config TARGET_GOYAWIFI
	bool "Samsung Galaxy Tab 3 Lite 7.0 Wi-Fi (SM-T110, PXA986)"
	select SOC_PXA988
	help
	  Samsung Galaxy Tab 3 Lite 7.0 Wi-Fi (SM-T110, codename goyawifi),
	  built around the Marvell PXA986 (PXA988 family, dual Cortex-A9).
	  U-Boot is chain-loaded by the Samsung S-Boot bootloader from the
	  KERNEL partition, in place of a Linux zImage.

endchoice

config SOC_PXA988
	bool
	select CPU_V7A
	select ENABLE_ARM_SOC_BOOT0_HOOK
	select SYS_L2CACHE_OFF
	select TIMER
	select MMP_TIMER
	help
	  Marvell PXA988 / PXA986 SoC: dual ARM Cortex-A9 MPCore with a
	  PL310 L2 cache, GIC, MMP APB timers, PXA UARTs and PXAv3 SDHCI.

config SYS_SOC
	default "mmp" if SOC_PXA988

config LNX_KRNL_IMG_TEXT_OFFSET_BASE
	default TEXT_BASE

source "board/samsung/coreprimevelte/Kconfig"
source "board/samsung/goyawifi/Kconfig"

endif
```

## board/samsung/goyawifi/Kconfig
```kconfig
if TARGET_GOYAWIFI

config SYS_BOARD
	default "goyawifi"

config SYS_VENDOR
	default "samsung"

config SYS_CONFIG_NAME
	default "pxa988"

endif
```

## configs/goyawifi_defconfig
```kconfig
CONFIG_ARM=y
CONFIG_SKIP_LOWLEVEL_INIT_ONLY=y
CONFIG_POSITION_INDEPENDENT=y
CONFIG_ARCH_CPU_INIT=y
CONFIG_ARCH_MMP=y
CONFIG_TEXT_BASE=0x10008000
CONFIG_SYS_MALLOC_LEN=0x2000000
CONFIG_NR_DRAM_BANKS=1
CONFIG_HAS_CUSTOM_SYS_INIT_SP_ADDR=y
CONFIG_CUSTOM_SYS_INIT_SP_ADDR=0x10000000
CONFIG_ENV_SIZE=0x4000
CONFIG_DM_GPIO=y
CONFIG_DEFAULT_DEVICE_TREE="pxa986-samsung-goyawifi"
CONFIG_DM_RESET=y
CONFIG_TARGET_GOYAWIFI=y
CONFIG_SYS_LOAD_ADDR=0x30000000
CONFIG_FIT=y
CONFIG_BOOTDELAY=3
CONFIG_BOOTSTD_FULL=y
# CONFIG_BOOTSTD_BOOTCOMMAND is not set
CONFIG_USE_PREBOOT=y
CONFIG_SYS_STDIO_DEREGISTER=y
# CONFIG_DISPLAY_CPUINFO is not set
CONFIG_BOARD_LATE_INIT=y
CONFIG_SYS_PROMPT="goyawifi# "
CONFIG_CMD_BOOTMENU=y
CONFIG_CMD_ABOOTIMG=y
CONFIG_CMD_GPIO=y
CONFIG_CMD_GPT=y
CONFIG_CMD_I2C=y
CONFIG_CMD_MMC=y
CONFIG_CMD_POWEROFF=y
CONFIG_CMD_USB=y
CONFIG_CMD_USB_MASS_STORAGE=y
CONFIG_CMD_CACHE=y
CONFIG_CMD_TIME=y
CONFIG_CMD_TIMER=y
# CONFIG_OF_UPSTREAM is not set
CONFIG_CLK=y
CONFIG_USB_FUNCTION_FASTBOOT=y
CONFIG_FASTBOOT_BUF_ADDR=0x30000000
CONFIG_FASTBOOT_BUF_SIZE=0x8000000
CONFIG_FASTBOOT_FLASH=y
CONFIG_FASTBOOT_FLASH_MMC_DEV=0
CONFIG_FASTBOOT_CMD_OEM_FORMAT=y
CONFIG_GPIO_HOG=y
CONFIG_MMP_GPIO=y
CONFIG_DM_I2C=y
CONFIG_SYS_I2C_MV=y
CONFIG_DM_KEYBOARD=y
CONFIG_BUTTON_KEYBOARD=y
CONFIG_SUPPORT_EMMC_BOOT=y
CONFIG_MMC_SDHCI=y
CONFIG_MMC_SDHCI_SDMA=y
CONFIG_MMC_SDHCI_MV=y
CONFIG_PHY=y
CONFIG_PHY_PXA988_USB=y
CONFIG_PINCTRL=y
CONFIG_PINCTRL_SINGLE=y
CONFIG_SYS_NS16550=y
CONFIG_SYS_NS16550_MEM32=y
CONFIG_USB=y
CONFIG_USB_EHCI_HCD=y
CONFIG_USB_EHCI_GENERIC=y
CONFIG_USB_GADGET=y
CONFIG_USB_GADGET_VENDOR_NUM=0x18d1
CONFIG_USB_GADGET_PRODUCT_NUM=0x4ee0
CONFIG_CI_UDC=y
CONFIG_VIDEO=y
CONFIG_VIDEO_FONT_16X32=y
# CONFIG_VIDEO_LOGO is not set
CONFIG_SYS_WHITE_ON_BLACK=y
CONFIG_VIDEO_SIMPLE=y
```

## drivers/phy/marvell/Kconfig
```kconfig
config MVEBU_COMPHY_SUPPORT
	bool "ComPhy SerDes driver"
	depends on ARMADA_3700 || ARMADA_8K
	help
	  Choose this option to add support
	  for Comphy driver.
	  This driver passes over the lanes
	  and initialize the lane depends on the
	  type and speed.

config PHY_PXA988_USB
	bool "Marvell PXA988/PXA986 USB 2.0 PHY"
	depends on PHY && ARCH_MMP
	help
	  Support for the USB 2.0 UTMI PHY found on Marvell PXA988 and
	  PXA986 SoCs, used together with the ChipIdea controller.
```
